## boards/shields/larskeeb/Kconfig.defconfig
```kconfig
if SHIELD_LARSKEEB

# Name must be less than 16 characters long!
config ZMK_KEYBOARD_NAME
    default "LarsKeeb"

endif
```

## config/boards/shields/larskeeb/Kconfig.shield
```kconfig
# No whitespace after the comma or in your keyboard name!
config SHIELD_LARSKEEB
    def_bool $(shields_list_contains,larskeeb)
```
